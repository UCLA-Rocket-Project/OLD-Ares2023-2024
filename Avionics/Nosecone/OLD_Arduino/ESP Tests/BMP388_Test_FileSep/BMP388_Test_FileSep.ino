////////////////////////////////////////////////////////////////////////////////////////////////////////////////////
// ------------------------------- Includes ----------------------------------------------------------------------//
////////////////////////////////////////////////////////////////////////////////////////////////////////////////////

#include "Globals.h"
#include "BMPSetup.h"


////////////////////////////////////////////////////////////////////////////////////////////////////////////////////
// ------------------------------- Object Declaration ------------------------------------------------------------//
////////////////////////////////////////////////////////////////////////////////////////////////////////////////////

Adafruit_BMP3XX bmp1;
Adafruit_BMP3XX bmp2;

///////////////////////////////////////////////////////////////////////////////////////////////////////////////////////////////////////
// ------------------------------- SETUP --------------------------------------------------------------------------------------------//
///////////////////////////////////////////////////////////////////////////////////////////////////////////////////////////////////////

void setup() {
  Serial.begin(115200);
  while (!Serial);

  if (reading_BMP)
    setupAltimeters(bmp1, bmp2);
}

///////////////////////////////////////////////////////////////////////////////////////////////////////////////////////////////////////
// ------------------------------- LOOP ---------------------------------------------------------------------------------------------//
///////////////////////////////////////////////////////////////////////////////////////////////////////////////////////////////////////
void loop() {

  // Code executes if BMP is being read
  if (reading_BMP) {
    if (!readAltimeter(bmp1, temp1, pressure1, altitude_m1)) {
      Serial.println("Failed to read Altimeter 1 :(");
    }
    if (!readAltimeter(bmp2, temp2, pressure2, altitude_m2)) {
      Serial.println("Failed to read Altimeter 2 :(");
    }
    
    if (print_values) {
      printAltimeter(1, temp1, pressure1, altitude_m1);
      printAltimeter(2, temp2, pressure2, altitude_m2);
    } 

  } 
  


  Serial.println();
  delay(1000);
}
